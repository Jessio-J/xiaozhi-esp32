## main/Kconfig.projbuild
```kconfig
menu "Melontalk Assistant"

config OTA_VERSION_URL
    string "OTA Version URL"
    default "https://api.tenclass.net/xiaozhi/ota/"
    help
        The application will access this URL to check for updates.

choice CONNECTION_TYPE
    prompt "Connection Type"
    default CONNECTION_TYPE_WEBSOCKET
    help
        网络数据传输协议
    config CONNECTION_TYPE_MQTT_UDP
        bool "MQTT + UDP"
    config CONNECTION_TYPE_WEBSOCKET
        bool "Websocket"
endchoice

config WEBSOCKET_URL
    depends on CONNECTION_TYPE_WEBSOCKET
    string "Websocket URL"
    default "wss://espapi.melontalk.com.cn/xiaozhi/v1/"
    help
        Communication with the server through websocket after wake up.

config WEBSOCKET_ACCESS_TOKEN
    depends on CONNECTION_TYPE_WEBSOCKET
    string "Websocket Access Token"
    default "test-token"
    help
        Access token for websocket communication.

choice DEVICE_ROLE
    prompt "Device Role"
    default DEVICE_ROLE_TAIWANESE_GIRLFRIEND
    help
        设备角色选择，决定设备的对话风格和行为模式
    config DEVICE_ROLE_TAIWANESE_GIRLFRIEND
        bool "台湾女友"
    config DEVICE_ROLE_ENGLISH_TEACHER
        bool "英语老师"
    config DEVICE_ROLE_STORYTELLER
        bool "童话故事大王"
endchoice

choice BOARD_TYPE
    prompt "Board Type"
    default BOARD_TYPE_BREAD_COMPACT_WIFI
    help
        Board type. 开发板类型
    config BOARD_TYPE_BREAD_COMPACT_WIFI
        bool "面包板新版接线（WiFi）"
    config BOARD_TYPE_BREAD_COMPACT_WIFI_LCD
        bool "面包板新版接线（WiFi）+ LCD"
    config BOARD_TYPE_BREAD_COMPACT_ML307
        bool "面包板新版接线（ML307 AT）"
    config BOARD_TYPE_XMINI_C3
        bool "虾哥 Mini C3"   
endchoice

choice DISPLAY_LCD_TYPE
    depends on BOARD_TYPE_BREAD_COMPACT_WIFI_LCD
    prompt "LCD Type"
    default LCD_ST7789_240X320
    help
        屏幕类型选择
    config LCD_ST7789_240X320
        bool "ST7789, 分辨率240*320, IPS"
    config LCD_ST7789_240X320_NO_IPS
        bool "ST7789, 分辨率240*320, 非IPS"    
    config LCD_ST7789_170X320
        bool "ST7789, 分辨率170*320"    
    config LCD_ST7789_172X320
        bool "ST7789, 分辨率172*320"       
    config LCD_ST7789_240X280
        bool "ST7789, 分辨率240*280"   
    config LCD_ST7789_240X240
        bool "ST7789, 分辨率240*240"         
    config LCD_ST7789_240X135
        bool "ST7789, 分辨率240*135"
    config LCD_ST7735_128X160
        bool "ST7735, 分辨率128*160"
    config LCD_ST7796_320X480
        bool "ST7796, 分辨率320*480"    
    config LCD_ILI9341_240X320
        bool "ILI9341, 分辨率240*320"
    config LCD_ILI9341_240X320_NO_IPS
        bool "ILI9341, 分辨率240*320, 非IPS"    
    config LCD_CUSTOM
        bool "自定义屏幕参数"  
endchoice

config USE_AUDIO_PROCESSING
    bool "启用语音唤醒与音频处理"
    default y
    depends on IDF_TARGET_ESP32S3 && USE_AFE
    help
        需要 ESP32 S3 与 AFE 支持
endmenu

menu "WiFi Configuration"

    config SET_MAC_ADDRESS_OF_TARGET_AP
        bool "Set MAC Address of Target AP"
        default n
        help
            Enable this option to set the MAC address of target AP.
            This can help ensure connecting to a specific AP when multiple APs have the same SSID.

endmenu
```
